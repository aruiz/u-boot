## arch/x86/cpu/bios_pc/Kconfig
```kconfig
# SPDX-License-Identifier: GPL-2.0+
#
# PC (BIOS) SoC - U-Boot loaded by legacy BIOS in 32-bit mode
#

config BIOS_PC
	bool
	select ARCH_EARLY_INIT_R
	imply SYS_NS16550
	imply AHCI_PCI
	imply I8254_TIMER
	help
	  Select this when building for a generic PC where U-Boot is loaded
	  by legacy BIOS (or SeaBIOS in QEMU) in 32-bit protected mode.
	  Assumes BIOS has already done POST and memory setup. RAM size
	  is read from standard CMOS locations.
```

## board/emulation/Kconfig
```kconfig
# SPDX-License-Identifier: GPL-2.0+
#
# Copyright (C) 2015, Bin Meng <bmeng.cn@gmail.com>

if VENDOR_EMULATION

choice
	prompt "Mainboard model"

config TARGET_QEMU_X86
	bool "QEMU x86"
	help
	  This is the QEMU emulated x86 board. U-Boot supports running
	  as a coreboot payload as well as bare boot without coreboot.
	  There are two types of x86 boards supported by QEMU which are
	  supported by U-Boot. They are via QEMU '-M pc', an i440FX/PIIX
	  chipset platform and '-M q35', a Q35/ICH9 chipset platform.

config TARGET_QEMU_X86_64
	bool "QEMU x86 64-bit"
	help
	  This is the QEMU emulated x86 64-bit board. With this config
	  U-Boot is built as a 64-bit binary. This allows testing while
	  this feature is being completed.

config TARGET_PC_BIOS
	bool "PC (BIOS)"
	help
	  Generic PC target when U-Boot is loaded by legacy BIOS (or
	  SeaBIOS in QEMU) in 32-bit mode. Assumes BIOS has already
	  done POST and memory setup. Provides basic text (serial),
	  serial I/O, and disk I/O with interrupt support (8259 PIC).

endchoice

source "board/emulation/qemu-x86/Kconfig"
source "board/emulation/pc-bios/Kconfig"

endif
```

## board/emulation/pc-bios/Kconfig
```kconfig
# SPDX-License-Identifier: GPL-2.0+
#
# PC (BIOS) target - U-Boot loaded by legacy BIOS in 32-bit mode
#

if TARGET_PC_BIOS

config SYS_BOARD
	default "pc-bios"

config SYS_VENDOR
	default "emulation"

config SYS_SOC
	default "bios_pc"

config TEXT_BASE
	default 0x100200

config BOARD_SPECIFIC_OPTIONS
	def_bool y
	select X86_LOAD_FROM_32_BIT
	select BIOS_PC
	select I8259_PIC
	select SYS_NS16550
	help
	  No PCI or storage bus probing; serial and video use BIOS/legacy
	  interfaces only (NS16550 serial, VESA via INT 10h).

endif
```

## configs/pc_bios_defconfig
```kconfig
# SPDX-License-Identifier: GPL-2.0+
#
# PC (BIOS) target: loaded by MBR at 0x100000. No PCI/storage bus probing;
# serial and video use BIOS/legacy only (NS16550, VESA INT 10h). UEFI (bootefi).
#
# Build the real-mode bootable image:
#   make pc_bios_defconfig && make -j$(nproc)
#   scripts/make-uboot-real.sh
#   -> produces u-boot-real.bin (MBR loads this to 0x100000, jumps in real mode)
#
# Quick QEMU test (with SeaBIOS, display + serial):
#   qemu-system-i386 -display gtk -kernel u-boot-dtb.bin -m 128 -serial stdio
#
CONFIG_X86=y
CONFIG_VENDOR_EMULATION=y
CONFIG_TARGET_PC_BIOS=y
CONFIG_SYS_MALLOC_LEN=0x2000000
CONFIG_NR_DRAM_BANKS=8
CONFIG_DEFAULT_DEVICE_TREE="pc-bios"
CONFIG_DEBUG_UART_BASE=0x3f8
CONFIG_DEBUG_UART_CLOCK=1843200
CONFIG_DEBUG_UART=y
CONFIG_X86_LOAD_FROM_32_BIT=y
CONFIG_I8259_PIC=y
CONFIG_FIT=y
CONFIG_BOOTSTD_FULL=y
CONFIG_BOOTSTAGE=y
CONFIG_SHOW_BOOT_PROGRESS=y
CONFIG_USE_PREBOOT=y
CONFIG_PREBOOT="setenv stdin serial,i8042-kbd"
CONFIG_SYS_CONSOLE_INFO_QUIET=y
CONFIG_LOG=y
CONFIG_LOGF_FUNC=y
CONFIG_DISPLAY_BOARDINFO_LATE=y
# No PCI or storage bus probing; use BIOS interfaces only
# CONFIG_PCI_INIT_R is not set
CONFIG_EFI_LOADER=y
CONFIG_CMD_BOOTEFI=y
CONFIG_CMD_BOOTEFI_BINARY=y
CONFIG_CMD_CPU=y
CONFIG_CMD_MEM_SEARCH=y
CONFIG_CMD_CAT=y
CONFIG_BOOTP_BOOTFILESIZE=y
CONFIG_CMD_TIME=y
CONFIG_CMD_BOOTSTAGE=y
CONFIG_ENV_IS_NOWHERE=y
# BIOS provides SMBIOS tables; don't generate/overwrite them
# CONFIG_GENERATE_SMBIOS_TABLE is not set
CONFIG_REGMAP=y
CONFIG_SYSCON=y
CONFIG_CPU=y
CONFIG_SYS_NS16550_PORT_MAPPED=y
# CONFIG_VIDEO_VESA is not set
CONFIG_FRAMEBUFFER_SET_VESA_MODE=y
CONFIG_FRAMEBUFFER_VESA_MODE_117=y
CONFIG_CONSOLE_SCROLL_LINES=5
CONFIG_CMD_DHRYSTONE=y
```
